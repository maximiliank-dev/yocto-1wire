## build/conf/bblayers.conf
```bitbake
# POKY_BBLAYERS_CONF_VERSION is increased each time build/conf/bblayers.conf
# changes incompatibly
POKY_BBLAYERS_CONF_VERSION = "2"

BBPATH = "${TOPDIR}"
BBFILES ?= ""
PROJECT_ROOT ?= "${TOPDIR}/.."


BBLAYERS ?= " \
  ${PROJECT_ROOT}/poky/meta \
  ${PROJECT_ROOT}/poky/meta-poky \
  ${PROJECT_ROOT}/poky/meta-yocto-bsp \
  ${PROJECT_ROOT}/meta-raspberrypi \
  ${PROJECT_ROOT}/meta-additional-layers \
  ${PROJECT_ROOT}/meta-openembedded/meta-oe \
  ${PROJECT_ROOT}/meta-openembedded/meta-python \
  ${PROJECT_ROOT}/meta-openembedded/meta-multimedia \
  ${PROJECT_ROOT}/meta-openembedded/meta-networking \
  ${PROJECT_ROOT}/meta-openembedded/meta-gnome \
  "
```

## meta-additional-layers/conf/layer.conf
```bitbake
# We have a conf and classes directory, add to BBPATH
BBPATH .= ":${LAYERDIR}"
# We have recipes-* directories, add to BBFILES
BBFILES += "${LAYERDIR}/recipes-*/*/*.bb \
            ${LAYERDIR}/recipes-*/*/*.bbappend"
BBFILE_COLLECTIONS += "meta-additional-layers"

# Define the pattern for your layer
BBFILE_PATTERN_meta-additional-layers = "^${LAYERDIR}/"
# Set the priority of your layer
BBFILE_PRIORITY_meta-additional-layers = "6"
# List the core layers you are compatible with
LAYERDEPENDS_meta-additional-layers = "core"
LAYERSERIES_COMPAT_meta-additional-layers = "scarthgap"

#REQUIRED_DISTRO_FEATURES = "systemd"
DISTRO_FEATURES:append = " systemd"
VIRTUAL-RUNTIME_init_manager ?= "systemd"
```
